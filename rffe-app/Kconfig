## rffe-app/Kconfig
```kconfig
#
# For a description of the syntax of this configuration file,
# see the file kconfig-language.txt in the NuttX tools repository.
#

config EXAMPLES_RFFE
	tristate "RFFE Application"
	default n
	---help---
		Enable the \"RFFE Application\"

if EXAMPLES_RFFE

config EXAMPLES_RFFE_PROGNAME
	string "Program name"
	default "rffe"
	depends on BUILD_LOADABLE
	---help---
		This is the name of the program that will be use when the NSH ELF
		program is installed.

config EXAMPLES_RFFE_PRIORITY
	int "Rffe task priority"
	default 100

config EXAMPLES_RFFE_STACKSIZE
	int "Rffe stack size"
	default 2048

endif
```
